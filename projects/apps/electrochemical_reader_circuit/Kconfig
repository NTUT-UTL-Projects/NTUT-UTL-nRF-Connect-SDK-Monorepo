## projects/apps/electrochemical_reader_circuit/Kconfig
```kconfig
#
# Copyright (c) 2018 Nordic Semiconductor
#
# SPDX-License-Identifier: LicenseRef-Nordic-5-Clause
#

source "Kconfig.zephyr"

source "${APPLICATION_SOURCE_DIR}/../../Kconfig"

menu "Nordic UART BLE GATT service sample"

config MY_BUILD_JOHNNY_OVAL_BOARD
	bool "Build for Johnny Oval Board"
	default n

config MY_BUILD_HOST_DEMO
	bool "Build for Host Demo"
	default n

endmenu
```

## projects/domains/peripheral_nus/Kconfig
```kconfig
#
# Copyright (c) 2018 Nordic Semiconductor
#
# SPDX-License-Identifier: LicenseRef-Nordic-5-Clause
#

source "Kconfig.zephyr"

menu "Nordic Peripheral NUS Demo"

config MY_COMMON_DEMO
	bool "Build for Common Demo"
	default n

config MY_RECEIVED_DATA_DEMO
	bool "Build for Received Data Demo"
	default n

endmenu
```

## projects/utils/Kconfig
```kconfig
#
# Copyright (c) 2018 Nordic Semiconductor
#
# SPDX-License-Identifier: LicenseRef-Nordic-5-Clause
#

menu "Utils"

config MY_BUILD_NRF_CONNECT_SDK
    bool "Enable support for nRF Connect SDK"
    select ZEPHYR_BASE

config MY_BUILD_STM32
    bool "Enable support for STM32"

config MY_BUILD_ZEPHYR_BASE
    bool "Enable support for ZEPHYR_BASE"

config MY_BUILD_FAKE_IMPL
    bool "Enable fake implementations"

endmenu
```
