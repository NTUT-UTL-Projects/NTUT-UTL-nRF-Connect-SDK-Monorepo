## apps/ad5940_electrochemical_module/Kconfig
```kconfig
#
# Copyright (c) 2018 Nordic Semiconductor
#
# SPDX-License-Identifier: LicenseRef-Nordic-5-Clause
#

source "Kconfig.zephyr"

source "${APPLICATION_SOURCE_DIR}/../../utils/Kconfig"

menu "Nordic UART BLE GATT service sample"

config JOHNNY_OVAL
	bool "Enable All in one Johnny oval"
	default n

config VIRUS_DETECTOR
	bool "Enable Virus detector"
	default n

endmenu
```
